## Kconfig
```kconfig
# Nuvoton Cortex-M4 Embedded Controller

# Copyright (c) 2023 Nuvoton Technology Corporation.
# SPDX-License-Identifier: Apache-2.0

# Drivers Kconfig
rsource "drivers/Kconfig"

source "Kconfig.zephyr"
```

## build/Kconfig/Kconfig.shield
```kconfig
osource "/home/bk911/projects/nvt/lenovo/lnv-npcx-zephyr/platforms/boards/shields/*/Kconfig.shield"
```

## drivers/Kconfig
```kconfig
# Nuvoton Cortex-M4 Embedded Controller

# Copyright (c) 2023 Nuvoton Technology Corporation.
# SPDX-License-Identifier: Apache-2.0

menu "Drivers"

config LNV_SYSTEM
	bool "Lenovo system driver"
	default y
	help
	  Enable Lenovo system driver

rsource "lnv_system/Kconfig"

endmenu
```

## drivers/lnv_system/Kconfig
```kconfig
# Nuvoton Cortex-M4 Embedded Controller

# Copyright (c) 2023 Nuvoton Technology Corporation.
# SPDX-License-Identifier: Apache-2.0

config LNV_SYSTEM_NPCX
	bool "Nuvoton NPCX Lenovo system driver"
	depends on SOC_FAMILY_NPCX
	default y
	help
	  This option enables the Lenovo system driver for the NPCX family of
	  processors. Currently, Zephyr doesn't provide the system related API.
	  The Lenovo system driver provides the low-level driver related to
	  chromium ec system functionality.


config LNV_SYSTEM_NPCX_INIT_PRIORITY
	int "lnv_system npcx initialization priority"
	default 10
	range 10 19
	help
	  This sets the npcx lnv_system driver initialization priority. The
	  lnv_system driver provides access to the NPCX reset cause and must be
	  higher priority than CONFIG_SYSTEM_PRE_INIT_PRIORITY.
```

## dts/bindings/gpio/poc-gpios.yaml
```yaml
# Copyright (c) 2023 Nuvoton Technology Corporation.
# SPDX-License-Identifier: Apache-2.0

description: POC GPIOs parent node

compatible: "poc-gpios"

child-binding:
  description: POC GPIOs child node
  properties:
    #
    # Must name this property [..-]gpios which
    # is treated specially (looks for #gpio-cells
    # in referenced node so that cell properties can
    # be specified).
    gpios:
      type: phandle-array
      required: true
    label:
      type: string
      description: |
        Human readable string describing the GPIO.
```

## platforms/boards/arm/npck3m7k_poc/Kconfig.board
```kconfig
# Copyright (c) 2022 Nuvoton Technology Corporation.
# SPDX-License-Identifier: Apache-2.0

config BOARD_NPCK3M7K_EVB
	bool "Nuvoton NPCK3M7K POC Development board"
	depends on SOC_NPCK3M7K
```

## platforms/boards/arm/npck3m7k_poc/Kconfig.defconfig
```kconfig
# Copyright (c) 2022 Nuvoton Technology Corporation.
# SPDX-License-Identifier: Apache-2.0

if BOARD_NPCK3M7K_EVB

config BOARD
	default "npck3m7k_poc"

endif # BOARD_NPCK3M7K_EVB

config SYS_CLOCK_TICKS_PER_SEC
	default 1000

config INPUT
	default y if KSCAN
```

## platforms/boards/arm/npcx9m6f_poc/Kconfig.board
```kconfig
# Copyright (c) 2022 Nuvoton Technology Corporation.
# SPDX-License-Identifier: Apache-2.0

config BOARD_NPCX9M6F_EVB
	bool "Nuvoton NPCX9M6F POC Development board"
	depends on SOC_NPCX9M6F
```

## platforms/boards/arm/npcx9m6f_poc/Kconfig.defconfig
```kconfig
# Copyright (c) 2022 Nuvoton Technology Corporation.
# SPDX-License-Identifier: Apache-2.0

if BOARD_NPCX9M6F_EVB

config BOARD
	default "npcx9m6f_poc"

endif # BOARD_NPCX9M6F_EVB

config SYS_CLOCK_TICKS_PER_SEC
	default 1000

config INPUT
	default y if KSCAN
```

## west.yml
```yaml
west:
  url: https://github.com/zephyrproject-rtos/west
  version: v0.7.2

manifest:
  remotes:
    - name: zephyrproject
      url-base: https://github.com/zephyrproject-rtos 
    - name: zephyrproject_nuvoton
      url-base: https://github.com/Nuvoton-EC

  projects:
    - name: zephyr-npck
      path: zephyr
      remote: zephyrproject_nuvoton
      revision: npcx_k3_1025
      # clone-depth: 1
      west-commands: scripts/west-commands.yml

    - name: cmsis
      remote: zephyrproject
      revision: 4b96cbb174678dcd3ca86e11e1f24bc5f8726da0
      path: modules/hal/cmsis
      groups:
        - hal
    - name: hal_microchip
      remote: zephyrproject
      revision: 5d079f1683a00b801373bbbbf5d181d4e33b30d5
      path: modules/hal/microchip
      groups:
        - hal

  self:
    path: lnv-npcx-zephyr
```
