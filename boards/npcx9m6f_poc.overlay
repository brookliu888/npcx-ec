/*
 * Copyright (c) 2023 Nuvoton Technology Corporation.
 *
 * SPDX-License-Identifier: Apache-2.0
 */

/ {
	chosen {
		zephyr,shell-uart = &uart1;
	};

	aliases {
		/* Connect gpio-out and gpio-in together */
		gpio-out = &gpio_pulse_out;
		gpio-in = &gpio_pulse_in;
		gpio-obs = &gpio_observe_out;
	};
};